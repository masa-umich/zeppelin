## CMakeLists.txt
```
cmake_minimum_required(VERSION 3.20.0)
find_package(Zephyr REQUIRED HINTS $ENV{ZEPHYR_BASE})
project(osprey_abseil_port_test LANGUAGES C CXX)

include("${CMAKE_CURRENT_LIST_DIR}/../../port/runtime.cmake")

include(FetchContent)
if(POLICY CMP0135)
    cmake_policy(SET CMP0135 NEW)
endif()
if(POLICY CMP0169)
    cmake_policy(SET CMP0169 OLD)
endif()

# Reuse the repository's bootstrap cache when present; otherwise fetch the
# same immutable Abseil release used by the Synnax client.
set(_abseil_cache "${CMAKE_CURRENT_LIST_DIR}/../../../.cache/synnax-deps/abseil_cpp")
if(EXISTS "${_abseil_cache}/CMakeLists.txt")
    set(FETCHCONTENT_SOURCE_DIR_ABSEIL "${_abseil_cache}" CACHE PATH "" FORCE)
endif()
FetchContent_Declare(abseil
    URL https://codeload.github.com/abseil/abseil-cpp/tar.gz/refs/tags/20250127.1
    URL_HASH SHA256=b396401fd29e2e679cace77867481d388c807671dc2acc602a0259eeb79b7811)
FetchContent_GetProperties(abseil)
if(NOT abseil_POPULATED)
    FetchContent_Populate(abseil)
endif()

find_package(Git REQUIRED)
function(abseil_patch_source source patch)
    set(_git ${CMAKE_COMMAND} -E env "GIT_CEILING_DIRECTORIES=${source}/.." "${GIT_EXECUTABLE}")
    execute_process(COMMAND ${_git} apply --reverse --check "${patch}"
        WORKING_DIRECTORY "${source}" RESULT_VARIABLE _already_applied
        OUTPUT_QUIET ERROR_QUIET)
    if(NOT _already_applied EQUAL 0)
        execute_process(COMMAND ${_git} apply "${patch}"
            WORKING_DIRECTORY "${source}" COMMAND_ERROR_IS_FATAL ANY)
    endif()
endfunction()
abseil_patch_source("${abseil_SOURCE_DIR}"
    "${CMAKE_CURRENT_LIST_DIR}/../../cmake/patches/abseil-zephyr.patch")

find_package(Python3 COMPONENTS Interpreter REQUIRED)
execute_process(COMMAND "${Python3_EXECUTABLE}"
    "${CMAKE_CURRENT_LIST_DIR}/../../cmake/patch_absl_zephyr.py" "${abseil_SOURCE_DIR}"
    COMMAND_ERROR_IS_FATAL ANY)
execute_process(COMMAND "${Python3_EXECUTABLE}"
    "${CMAKE_CURRENT_LIST_DIR}/../../cmake/patch_absl_time.py" "${abseil_SOURCE_DIR}"
    COMMAND_ERROR_IS_FATAL ANY)

set(CMAKE_CXX_STANDARD 20)
set(CMAKE_CXX_STANDARD_REQUIRED ON)
set(CMAKE_HAVE_LIBC_PTHREAD ON CACHE BOOL "" FORCE)
set(ABSL_BUILD_TESTING OFF CACHE BOOL "" FORCE)
set(ABSL_ENABLE_INSTALL OFF CACHE BOOL "" FORCE)
set(ABSL_PROPAGATE_CXX_STD ON CACHE BOOL "" FORCE)
add_subdirectory("${abseil_SOURCE_DIR}" "${abseil_BINARY_DIR}" EXCLUDE_FROM_ALL)
target_compile_definitions(absl_base PRIVATE O_CLOEXEC=0)
set(_abseil_port_include "${CMAKE_CURRENT_LIST_DIR}/../../port/include")

function(abseil_zephyr_targets directory)
    get_property(_targets DIRECTORY "${directory}" PROPERTY BUILDSYSTEM_TARGETS)
    foreach(_target IN LISTS _targets)
        get_target_property(_type "${_target}" TYPE)
        if(_type STREQUAL "STATIC_LIBRARY" OR _type STREQUAL "OBJECT_LIBRARY")
            target_link_libraries("${_target}" PRIVATE zephyr_interface)
            target_include_directories("${_target}" BEFORE PRIVATE
                "${_abseil_port_include}")
            target_compile_definitions("${_target}" PRIVATE
                _GLIBCXX_HAS_GTHREADS=1 _GLIBCXX_HAVE_TLS=1)
            add_dependencies("${_target}" zephyr_generated_headers)
        endif()
    endforeach()
    get_property(_children DIRECTORY "${directory}" PROPERTY SUBDIRECTORIES)
    foreach(_child IN LISTS _children)
        abseil_zephyr_targets("${_child}")
    endforeach()
endfunction()
abseil_zephyr_targets("${abseil_SOURCE_DIR}")

zephyr_compile_definitions(_XOPEN_SOURCE=700 NDEBUG=1
    $<$<COMPILE_LANGUAGE:CXX>:_GLIBCXX_HAS_GTHREADS=1>
    $<$<COMPILE_LANGUAGE:CXX>:_GLIBCXX_HAVE_TLS=1>)
option(OSPREY_SYNNAX_STRIP_LOGS
    "Omit Abseil stream logging and CHECK messages (failed checks still abort)" ON)
if(OSPREY_SYNNAX_STRIP_LOGS)
    zephyr_compile_definitions(ABSL_MIN_LOG_LEVEL=4)
endif()
zephyr_include_directories("${_abseil_port_include}")
target_sources(app PRIVATE
    src/main.cpp
    ../../port/std_thread.cpp
    ../../src/atomic64.cpp)
target_link_libraries(app PRIVATE absl::malloc_internal absl::synchronization absl::time)
```

## prj.conf
```kconfig
CONFIG_CPP=y
CONFIG_STD_CPP20=y
CONFIG_REQUIRES_FULL_LIBCPP=y
CONFIG_CPP_EXCEPTIONS=y
CONFIG_CPP_RTTI=y
CONFIG_PICOLIBC=y
CONFIG_POSIX_API=y
CONFIG_POSIX_THREADS_EXT=y
CONFIG_DYNAMIC_THREAD=y
CONFIG_DYNAMIC_THREAD_ALLOC=y
CONFIG_DYNAMIC_THREAD_STACK_SIZE=4096
CONFIG_POSIX_THREAD_THREADS_MAX=4
CONFIG_POSIX_THREAD_KEYS_MAX=16
CONFIG_MAX_PTHREAD_MUTEX_COUNT=64
CONFIG_MAX_PTHREAD_COND_COUNT=32
CONFIG_MAIN_STACK_SIZE=4096
CONFIG_HEAP_MEM_POOL_SIZE=32768
CONFIG_COMMON_LIBC_MALLOC_ARENA_SIZE=8192
CONFIG_SIZE_OPTIMIZATIONS_AGGRESSIVE=y
CONFIG_PRINTK=y
CONFIG_CONSOLE=y
CONFIG_UART_CONSOLE=y
CONFIG_THREAD_STACK_INFO=y
```

## src/main.cpp
```c
#include <absl/base/internal/low_level_alloc.h>
#include <absl/synchronization/mutex.h>
#include <absl/time/time.h>
#include <zephyr/kernel.h>
#include <zephyr/sys/printk.h>

#include <array>
#include <cstddef>
#include <string>
#include <thread>

namespace {
constexpr int kThreads = 2;
constexpr int kIncrementsPerThread = 200;
absl::Mutex counter_mutex;
absl::CondVar condition;
int counter = 0;
bool notified = false;

size_t available_kernel_chunks() {
    void* chunks[256]{};
    size_t count = 0;
    while (count < std::size(chunks)) {
        void* p = k_malloc(128);
        if (p == nullptr) break;
        chunks[count++] = p;
    }
    for (size_t i = 0; i < count; ++i) k_free(chunks[i]);
    return count;
}

bool test_allocator_arenas() {
    auto* warm = absl::base_internal::LowLevelAlloc::NewArena(0);
    if (!absl::base_internal::LowLevelAlloc::DeleteArena(warm)) return false;
    const size_t before = available_kernel_chunks();
    for (int iteration = 0; iteration < 10; ++iteration) {
        auto* arena = absl::base_internal::LowLevelAlloc::NewArena(0);
        std::array<void*, 48> blocks{};
        for (size_t i = 0; i < blocks.size(); ++i) {
            blocks[i] = absl::base_internal::LowLevelAlloc::AllocWithArena(
                12 + ((i * 37 + iteration * 11) % 173), arena);
            if (blocks[i] == nullptr) return false;
        }
        for (size_t i = blocks.size(); i-- > 0;) {
            absl::base_internal::LowLevelAlloc::Free(blocks[i]);
        }
        if (!absl::base_internal::LowLevelAlloc::DeleteArena(arena)) return false;
    }
    return available_kernel_chunks() == before;
}

void increment_worker() {
    for (int i = 0; i < kIncrementsPerThread; ++i) {
        counter_mutex.Lock();
        ++counter;
        if (i < 3) k_msleep(1);
        counter_mutex.Unlock();
    }
}

bool test_mutex_and_condition_variable() {
    std::thread a(increment_worker);
    std::thread b(increment_worker);
    a.join();
    b.join();
    if (counter != kThreads * kIncrementsPerThread) return false;

    // Hold the mutex while starting the notifier. It cannot signal until
    // Wait atomically releases the mutex and enrolls this thread.
    counter_mutex.Lock();
    std::thread notifier([] {
        counter_mutex.Lock();
        notified = true;
        condition.Signal();
        counter_mutex.Unlock();
    });
    while (!notified) condition.Wait(&counter_mutex);
    counter_mutex.Unlock();
    notifier.join();
    return notified;
}

bool test_time_formatting() {
    const absl::Time instant = absl::FromUnixSeconds(1700000000);
    absl::TimeZone utc;
    absl::TimeZone new_york;
    const bool utc_loaded = absl::LoadTimeZone("UTC", &utc);
    const bool new_york_rejected = !absl::LoadTimeZone("America/New_York", &new_york);
    const std::string utc_text = absl::FormatTime("%Y-%m-%d %H:%M:%S", instant, utc);
    const std::string offset_text =
        absl::FormatTime("%Y-%m-%d %H:%M:%S", instant, absl::FixedTimeZone(3600));
    const bool utc_ok = utc_loaded && utc_text == "2023-11-14 22:13:20";
    const bool offset_ok = offset_text == "2023-11-14 23:13:20";
    printk("ABSL_TIME_TEST utc=%d offset=%d unsupported_zone=%d\n", utc_ok, offset_ok,
           new_york_rejected);
    return utc_ok && offset_ok && new_york_rejected;
}
}  // namespace

static int run_test() {
    printk("absl: test driver started\n");
    const bool allocator_ok = test_allocator_arenas();
    printk("absl: allocator result %d\n", allocator_ok);
    const bool synchronization_ok = test_mutex_and_condition_variable();
    printk("ABSL_PORT_TEST allocator=%d sync=%d\n", allocator_ok, synchronization_ok);
    const bool time_ok = test_time_formatting();
    return allocator_ok && synchronization_ok && time_ok ? 0 : 1;
}

int main() {
    printk("absl: starting driver\n");
    int result = 1;
    std::thread driver([&] { result = run_test(); });
    driver.join();
    return result;
}
```
