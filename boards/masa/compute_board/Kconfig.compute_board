## boards/masa/compute_board/board.yml
```yaml
board:
  name: compute_board
  full_name: MASA Compute Board
  vendor: masa
  socs:
    - name: stm32h725xx
```

## osprey-app/tests/abseil/testcase.yaml
```yaml
tests:
  osprey.abseil.port:
    platform_allow:
      - qemu_cortex_m3
    tags:
      - abseil
      - synchronization
      - allocator
    harness: console
    harness_config:
      type: multi_line
      ordered: true
      regex:
        - "ABSL_PORT_TEST allocator=1 sync=1"
        - "ABSL_TIME_TEST utc=1 offset=1 unsupported_zone=1"
```

## osprey-app/tests/runtime/testcase.yaml
```yaml
tests:
  osprey.runtime_port:
    platform_allow:
      - qemu_cortex_m3
    integration_platforms:
      - qemu_cortex_m3
    tags:
      - cpp
      - posix
      - runtime
    harness: console
    harness_config:
      type: one_line
      regex:
        - "runtime-port: PASS"
```
